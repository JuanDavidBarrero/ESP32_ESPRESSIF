## GpioLedButton/src/Kconfig.projbuild
```kconfig
menu "Configuration button"
    config IS_ACTIVATE
        bool "Activate by interrupt"
        default false
        help
            use it to set the button with interrupt

endmenu
```

## HelloWorld/src/Kconfig.projbuild
```kconfig
menu "Example Configuration"

    config USER_NAME
            string "Enter your name"
            default ""
            help
                Enter your name to saludate you.

    config USER_AGE
            int "How old are you"
            default 18
            help
                Enter your age to acces to the code 


endmenu
```

## NeoPixels/src/Kconfig.projbuild
```kconfig
menu "Example configuration"

config LED_STRIP_LEN
    int "Number of LED pixel"
    default 8
config LED_STRIP_GPIO
    int "GPIO pin number connected to DI"
    default 5
    help
        Choose GPIO number connected to DI (DIN on some products).

config LED_STRIP_BRIGHTNESS
    int "Set the brightness of the strip"
    default 120
    help
        Choose the brightness of the strip
config LED_STRIP_FLUSH_TIMEOUT
    int "Strip flush timeout, ms"
    default 1000

config LED_STRIP_PAUSE_LENGTH
	int "Delay between flushes, us"
	default 50
	help
		This delay is between the sending full data to the all LEDs in strip.
		Without this delay, a bug with "missing" pixels is possible: 
		if delay between calls to led_strip_flush() is small, the LEDs consider
		the new data package sent to all LEDs in strip to be a continuation of
		the previous one.
endmenu
```

## Network/WifiTest/src/Kconfig.projbuild
```kconfig
menu "My WiFI Configuration"

    config MY_SSID
            string "Enter your name SSID"
            default ""
            help
                Enter your SSID to connecto to WiFI.

    config MY_PASSWORD
            string "Enter your PASSWORD"
            default ""
            help
                Enter the passwork in order to connect

    config MAXIMUM_RETRY
        int "How many times should it try to connect"
        default 3
        help
            Enter how many times the process should be runing before shutdown

endmenu
```
